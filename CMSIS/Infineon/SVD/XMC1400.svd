# XMC1400 register map
Vendor: Infineon; File version: 1.0.6 (Reference Manual v1.0)
SVD file
CPU: CM0 r0p0, little endian, no MPU, no FPU, 2 interrupt priority bits
Registers are 32-bit, read-write, reset 0x0 unless marked. A register's access mark holds for its fields unless they carry their own. Offsets are from the block's base; lines under a group give offsets from that group; [hi:lo] are bit positions; {n}, {i} and the like mark numbered series; 'fields as' and 'values as' point back to an identical list; <NAME> marks a mode.

## Memory map
0x40000000 PAU size 0x10000 — PAU Unit
0x40010000 SCU_GENERAL size 0x200 — System Control Unit
0x40010038 SCU_INTERRUPT size 0x30 — System Control Unit
0x40010200 SCU_POWER size 0x100 — System Control Unit
0x40010300 SCU_CLK size 0x100 — System Control Unit
0x40010400 SCU_RESET size 0x100 — System Control Unit
0x40010500 COMPARATOR size 0xC00 — System Control Unit
0x40010600 ERU0 size 0x30 — Event Request Unit 0
0x40010630 ERU1 size 0xD0 — Event Request Unit 1
0x40010A00 RTC size 0x100 — Real Time Clock
0x40011000 SCU_ANALOG size 0x100 — System Control Unit
0x40020000 WDT size 0x10000 — Watch Dog Timer
0x40030000 MATH size 0x60 — MATH Unit
0x40040000 PORT0 size 0x100
0x40040100 PORT1 size 0x100
0x40040200 PORT2 size 0x100
0x40040300 PORT3 size 0x100
0x40040400 PORT4 size 0x100
0x40050000 NVM size 0x100 — NVM Unit
0x48000000 USIC0_CH0 size 0x200 — Universal Serial Interface Controller 0
0x48000008 USIC0 size 0x4 — Universal Serial Interface Controller 0
0x48000200 USIC0_CH1 size 0x200 — Universal Serial Interface Controller 0
0x48004000 USIC1_CH0 size 0x200 — Universal Serial Interface Controller 1
0x48004008 USIC1 size 0x4 — Universal Serial Interface Controller 1
0x48004200 USIC1_CH1 size 0x200 — Universal Serial Interface Controller 1
0x48020000 PRNG size 0x10 — PRNG Unit
0x48030000 VADC size 0x400 — Analog to Digital Converter
0x48030400 VADC_G0 size 0x400 — Analog to Digital Converter
0x48030800 VADC_G1 size 0x400 — Analog to Digital Converter
0x48034000 SHS0 size 0x200 — Sample and Hold ADC Sequencer
0x48040000 CCU40 size 0x100 — Capture Compare Unit 4 - Unit 0
0x48040100 CCU40_CC40 size 0x100 — Capture Compare Unit 4 - Unit 0
0x48040200 CCU40_CC41 size 0x100 — Capture Compare Unit 4 - Unit 0
0x48040300 CCU40_CC42 size 0x100 — Capture Compare Unit 4 - Unit 0
0x48040400 CCU40_CC43 size 0x100 — Capture Compare Unit 4 - Unit 0
0x48044000 CCU41 size 0x100 — Capture Compare Unit 4 - Unit 1
0x48044100 CCU41_CC40 size 0x100 — Capture Compare Unit 4 - Unit 1
0x48044200 CCU41_CC41 size 0x100 — Capture Compare Unit 4 - Unit 1
0x48044300 CCU41_CC42 size 0x100 — Capture Compare Unit 4 - Unit 1
0x48044400 CCU41_CC43 size 0x100 — Capture Compare Unit 4 - Unit 1
0x50000000 CCU80 size 0x100 — Capture Compare Unit 8 - Unit 0
0x50000100 CCU80_CC80 size 0x100 — Capture Compare Unit 8 - Unit 0
0x50000200 CCU80_CC81 size 0x100 — Capture Compare Unit 8 - Unit 0
0x50000300 CCU80_CC82 size 0x100 — Capture Compare Unit 8 - Unit 0
0x50000400 CCU80_CC83 size 0x100 — Capture Compare Unit 8 - Unit 0
0x50004000 CCU81 size 0x100 — Capture Compare Unit 8 - Unit 1
0x50004100 CCU81_CC80 size 0x100 — Capture Compare Unit 8 - Unit 1
0x50004200 CCU81_CC81 size 0x100 — Capture Compare Unit 8 - Unit 1
0x50004300 CCU81_CC82 size 0x100 — Capture Compare Unit 8 - Unit 1
0x50004400 CCU81_CC83 size 0x100 — Capture Compare Unit 8 - Unit 1
0x50010000 POSIF0 size 0x4000 — Position Interface 0
0x50014000 POSIF1 size 0x4000 — Position Interface 1
0x50020000 LEDTS0 size 0x2C — LED and Touch Sense Unit 0
0x50020400 LEDTS1 size 0x2C — LED and Touch Sense Unit 1
0x50020800 LEDTS2 size 0x2C — LED and Touch Sense Unit 2
0x50030000 BCCU0 size 0x3C — BCCU Unit 0
{0x5003003C+0x14*n} BCCU0_CH{n} size 0x14 (n=0..8) — BCCU Unit 0
0x5003017C BCCU0_DE0 size 0xC — BCCU Unit 0
0x50030188 BCCU0_DE1 size 0xC — BCCU Unit 0
0x50030194 BCCU0_DE2 size 0xC — BCCU Unit 0
0x50040000 CAN size 0x200 — Controller Area Networks
0x50040200 CAN_NODE0 size 0x100 — Controller Area Networks
0x50040300 CAN_NODE1 size 0x100 — Controller Area Networks
0x50041000 CAN_MO size 0x400 — Controller Area Networks
0xE000E000 PPB size 0x1000 — Cortex-M0 Private Peripheral Block

## Interrupts
0 IRQ0 (SCU_INTERRUPT) — System Control
1 IRQ1 (SCU_INTERRUPT) — System Control
2 IRQ2 (SCU_INTERRUPT) — System Control
3 IRQ3 (ERU0) — External Request Unit 0
4 IRQ4 (ERU0) — External Request Unit 0
5 IRQ5 (ERU0) — External Request Unit 0
6 IRQ6 (ERU0) — External Request Unit 0
7 IRQ7 (MATH) — MATH Unit 0
8 IRQ8 (LEDTS2) — LED and Touch Sense Control Unit (Module 2)
9 IRQ9 (USIC0) — Universal Serial Interface Channel (Module 0)
10 IRQ10 (USIC0) — Universal Serial Interface Channel (Module 0)
11 IRQ11 (USIC0) — Universal Serial Interface Channel (Module 0)
12 IRQ12 (USIC0) — Universal Serial Interface Channel (Module 0)
13 IRQ13 (USIC0) — Universal Serial Interface Channel (Module 0)
14 IRQ14 (USIC0) — Universal Serial Interface Channel (Module 0)
15 IRQ15 (VADC) — Analog to Digital Converter Common Block 0
16 IRQ16 (VADC) — Analog to Digital Converter Common Block 0
17 IRQ17 (VADC_G0) — Analog to Digital Converter Group 0
18 IRQ18 (VADC_G0) — Analog to Digital Converter Group 0
19 IRQ19 (VADC_G1) — Analog to Digital Converter Group 1
20 IRQ20 (VADC_G1) — Analog to Digital Converter Group 1
21 IRQ21 (CCU40) — Capture Compare Unit 4 (Module 0)
22 IRQ22 (CCU40) — Capture Compare Unit 4 (Module 0)
23 IRQ23 (CCU40) — Capture Compare Unit 4 (Module 0)
24 IRQ24 (CCU40) — Capture Compare Unit 4 (Module 0)
25 IRQ25 (CCU80) — Capture Compare Unit 8 (Module 0)
26 IRQ26 (CCU80) — Capture Compare Unit 8 (Module 0)
27 IRQ27 (POSIF0) — Position Interface (Module 0)
28 IRQ28 (POSIF0) — Position Interface (Module 0)
29 IRQ29 (LEDTS0) — LED and Touch Sense Control Unit (Module 0)
30 IRQ30 (LEDTS1) — LED and Touch Sense Control Unit (Module 1)
31 IRQ31 (BCCU0) — Brightness and Color Control Unit 0

## Notices in the file
Copyright (C) 2016 Infineon Technologies AG. All rights reserved.
Infineon Technologies AG (Infineon) is supplying this software for use with
Infineon's microcontrollers.  This file can be freely distributed within
development tools that are supporting such microcontrollers.
THIS SOFTWARE IS PROVIDED "AS IS".  NO WARRANTIES, WHETHER EXPRESS, IMPLIED
OR STATUTORY, INCLUDING, BUT NOT LIMITED TO, IMPLIED WARRANTIES OF
MERCHANTABILITY AND FITNESS FOR A PARTICULAR PURPOSE APPLY TO THIS SOFTWARE.
INFINEON SHALL NOT, IN ANY CIRCUMSTANCES, BE LIABLE FOR SPECIAL, INCIDENTAL,
OR CONSEQUENTIAL DAMAGES, FOR ANY REASON WHATSOEVER.
